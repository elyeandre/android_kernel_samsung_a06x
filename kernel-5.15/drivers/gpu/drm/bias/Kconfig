## kernel-5.15/drivers/gpu/drm/bias/Kconfig
```kconfig
# SPDX-License-Identifier: GPL-2.0-only

config DRM_BIAS
    tristate "LCD Bias"
	help
	  LCD Bias for lcd driver
```

## kernel-5.15/drivers/input/fingerprint/Kconfig
```kconfig
#
#Fingerprint
#
menu "Finger support"

config MTK_FINGERPRINT
	tristate "Mediatek Fingerprint"
	default y
	help
	Fingerprint mtk driver enable/disable in the kernel.
	Say Y here if you want to use mediatek fingerprint driver,
	fingerprint driver will support fingerprint function in REE,
	it supports Goodix's GF316M/GF318M/GF3118M/GF518M/GF5118M/GF516M/GF816M/GF3208/GF3206/GF3266/GF3288/GF5206/GF5216/GF5208... device.

config FPC_FINGERPRINT
	tristate "Fpc Fingerprint"
	default m
	help
	Goodix Fingerprint chip GF316M/GF318M/GF3118M/GF518M/GF5118M/GF516M/GF816M/GF3208/GF3206/GF3266/GF3288/GF5206/GF5216/GF5208 TEE driver.

if MTK_FINGERPRINT

config GOODIX_FINGERPRINT
	tristate "Goodix Fingerprint"
	default m
	help
	Goodix Fingerprint chip GF316M/GF318M/GF3118M/GF518M/GF5118M/GF516M/GF816M/GF3208/GF3206/GF3266/GF3288/GF5206/GF5216/GF5208 TEE driver.

config GOODIX_SENSOR_TYPE
	string "SENSOR_TYPE"
	default "GF318M"
	help
	Must input sensor type, or default is GF316M GF318M GF3118M GF518M GF5118M GF516M GF816M GF3208 GF3206 GF3266 GF3288 GF5206 GF5216 GF5208.

endif

config SILEAD_FP
	tristate "Silead Fingerprint driver support"
	help
	This supports Silead Fingerprint drivers.
	  
config SILEAD_FP_PLATFORM
	tristate "Silead platformm Fingerprint driver support"
	help
	This supports Silead platform Fingerprint drivers.

endmenu
```

## kernel-5.15/drivers/input/fingerprint/silead/Kconfig
```kconfig
#
# Silead Fingerprint driver configuration
#

config SILEAD_FP
	tristate "Silead Fingerprint driver support"
	help
	  This supports Silead Fingerprint drivers.
	  
config SILEAD_FP_PLATFORM
	tristate "Silead platformm Fingerprint driver support"
	help
	  This supports Silead platform Fingerprint drivers.
```

## kernel-5.15/drivers/input/sar/stk501xx/Kconfig
```kconfig
#
# Mediatek STK501XX_SAR
#

config STK501XX_SAR
	tristate "STK501XX_SAR driver"
	depends on I2C
	help
	  Say Y here if you have STK501XX_SAR controller
	  chip in your system.
	  If unsure, say N.
	  To compile this driver as a module, choose M here: the
	  module will be called  STK501XX_SAR key.
```

## kernel-5.15/drivers/input/sar/sx937x/Kconfig
```kconfig
#
# Mediatek SX937X_SAR
#

config SX937X_SAR
	tristate "SX937X_SAR driver"
	depends on I2C
	help
	  Say Y here if you have SX937X_SAR controller
	  chip in your system.
	  If unsure, say N.
	  To compile this driver as a module, choose M here: the
	  module will be called  SX937X_SAR key.
```
